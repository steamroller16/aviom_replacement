/*-----------------------------------------------------------------------------
File Name   :
Author      : Sam Soundar
Date        : yyyy-mm-dd
Description :
------------------------------------------------------------------------------*/

/* Includes ------------------------------------------------------------------*/
#include "main.h"


/* Local Macros/Constants/Structures -----------------------------------------*/
#define AUDIO_SAMPLES_BUFFER_LENGTH (32)
#define NUM_INPUT_CHANNELS          (16)


/* Public Global Variables ---------------------------------------------------*/
extern ETH_HandleTypeDef heth;

extern I2S_HandleTypeDef hi2s2;

__ALIGN_BEGIN ETH_DMADescTypeDef  DMARxDscrTab[ETH_RXBUFNB] __ALIGN_END;/* Ethernet Rx MA Descriptor */
__ALIGN_BEGIN ETH_DMADescTypeDef  DMATxDscrTab[ETH_TXBUFNB] __ALIGN_END;/* Ethernet Tx DMA Descriptor */
__ALIGN_BEGIN uint8_t Rx_Buff[ETH_RXBUFNB][ETH_RX_BUF_SIZE] __ALIGN_END; /* Ethernet Receive Buffer */
__ALIGN_BEGIN uint8_t Tx_Buff[ETH_TXBUFNB][ETH_TX_BUF_SIZE] __ALIGN_END; /* Ethernet Transmit Buffer */


/* Private Global Variables --------------------------------------------------*/
static int32_t SinTable[] = {
//    0,7,13,20,27,33,40,47,53,60,67,73,80,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-7
//    0, 13, 27, 40, 53, 67, 80, 93, 106, 119, 132, 145, 158,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 -13,
//    0, 0, 13, 13, 27, 27, 40, 40, 53, 53, 67, 67, 80,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 -13,
    0, 0, 27, 27, 53, 53, 80, 80, 106, 106, 132, 132,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 -27,
};

static int32_t AudioSamplesBuffer[AWE_INTERFACE_AUDIO_BLOCK_SIZE][AWE_INTERFACE_NUM_INPUT_CHANNELS];
static uint8_t AudioSamplesBufferIndex = 0;


/* Private Function Prototypes -----------------------------------------------*/


/* Function Implementations --------------------------------------------------*/
void AviomReceiver_Init(void)
{
    uint16_t i;
    for (i=0; i<sizeof(SinTable)/sizeof(SinTable[0]); i++)
    {
        SinTable[i] = ((SinTable[i] & 0x0000FFFF) << 16) + ((SinTable[i] & 0xFFFF0000) >> 16);
        SinTable[i] <<= 8; // Make sine wave level audible
    }

    /* Initialize Tx Descriptors list: Chain Mode */
    HAL_ETH_DMATxDescListInit(&heth, DMATxDscrTab, &Tx_Buff[0][0], ETH_TXBUFNB);

    /* Initialize Rx Descriptors list: Chain Mode  */
    HAL_ETH_DMARxDescListInit(&heth, DMARxDscrTab, &Rx_Buff[0][0], ETH_RXBUFNB);

    /* Enable MAC and DMA transmission and reception */
    HAL_ETH_Start(&heth);

    /* Read Register Configuration */
    uint32_t regvalue;
    HAL_ETH_ReadPHYRegister(&heth, PHY_ISFR, &regvalue);
    regvalue |= (PHY_ISFR_INT4);

    /* Enable Interrupt on change of link status */
    HAL_ETH_WritePHYRegister(&heth, PHY_ISFR , regvalue );

    /* Read Register Configuration */
    HAL_ETH_ReadPHYRegister(&heth, PHY_ISFR , &regvalue);
}

void AviomReceiver_MainLoopProcess(void)
{
    #if 0
    if ((HAL_I2S_GetState(&hi2s2) == HAL_I2S_STATE_READY) &&
        ( (AudioSamplesBufferIndex - AudioSamplesBufferOutdex >= 64) ||
          (AudioSamplesBufferIndex < AudioSamplesBufferOutdex) ))
    {
        HAL_GPIO_WritePin(DEBUG4_GPIO_Port, DEBUG4_Pin, GPIO_PIN_SET);
        HAL_I2S_Transmit_IT(&hi2s2, (uint16_t *)AudioSamplesBuffer[0][AudioSamplesBufferOutdex], 64*2);
        AudioSamplesBufferOutdex += 64;
        if (AudioSamplesBufferOutdex >= AWE_INTERFACE_AUDIO_BLOCK_SIZE)
        {
            AudioSamplesBufferOutdex = 0;
        }
        HAL_GPIO_WritePin(DEBUG4_GPIO_Port, DEBUG4_Pin, GPIO_PIN_RESET);
    }
    #endif
}

void HAL_ETH_RxCpltCallback(ETH_HandleTypeDef *dummy)
{
    if (HAL_ETH_GetReceivedFrame_IT(&heth) == HAL_OK)
    {
        if (heth.RxFrameInfos.length == 100)
        {
            uint8_t *buffer = (uint8_t *)heth.RxFrameInfos.buffer;
            uint8_t sampleIndex = 0;

            for (sampleIndex = 0; sampleIndex < 16; sampleIndex++)
            {
                AudioSamplesBuffer[AudioSamplesBufferIndex][sampleIndex] =
                    (buffer[0] << 24) + (buffer[1] << 16) + (buffer[2] << 8);
                buffer += 3;
            }
            AudioSamplesBufferIndex++;

            for (sampleIndex = 0; sampleIndex < 16; sampleIndex++)
            {
                AudioSamplesBuffer[AudioSamplesBufferIndex][sampleIndex] =
                    (buffer[0] << 24) + (buffer[1] << 16) + (buffer[2] << 8);
                buffer += 3;
            }
            AudioSamplesBufferIndex++;

            if (AudioSamplesBufferIndex == AWE_INTERFACE_AUDIO_BLOCK_SIZE)
            {
                AudioSamplesBufferIndex = 0;
                // TODO: add samples to AWE
            }
        }
        else
        {
            HAL_GPIO_TogglePin(DEBUG3_GPIO_Port, DEBUG3_Pin);
        }

        __IO ETH_DMADescTypeDef *dmarxdesc;
        /* Release descriptors to DMA */
        /* Point to first descriptor */
        dmarxdesc = heth.RxFrameInfos.FSRxDesc;
        /* Set Own bit in Rx descriptors: gives the buffers back to DMA */
        uint32_t i;
        for (i=0; i< heth.RxFrameInfos.SegCount; i++)
        {
            dmarxdesc->Status |= ETH_DMARXDESC_OWN;
            dmarxdesc = (ETH_DMADescTypeDef *)(dmarxdesc->Buffer2NextDescAddr);
        }
        /* Clear Segment_Count */
        heth.RxFrameInfos.SegCount =0;
        /* When Rx Buffer unavailable flag is set: clear it and resume reception */
        if ((heth.Instance->DMASR & ETH_DMASR_RBUS) != (uint32_t)RESET)
        {
          /* Clear RBUS ETHERNET DMA flag */
          heth.Instance->DMASR = ETH_DMASR_RBUS;
          /* Resume DMA reception */
          heth.Instance->DMARPDR = 0;
        }
    }
}
